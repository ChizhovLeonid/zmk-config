## config/west.yml
```yaml
manifest:
  remotes:
    - name: zmkfirmware
      url-base: https://github.com/zmkfirmware
    - name: ftc
      url-base: https://github.com/ftc
    - name: leo
      url-base: https://github.com/ChizhovLeonid
  projects:
    - name: zmk
      remote: leo
      revision: main
      import: app/west.yml
  self:
    path: config
```
